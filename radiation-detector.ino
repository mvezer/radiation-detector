#include "secrets.h"
#include "PubSubClient.h"
#include <WiFiClient.h>
#include <SPI.h>
#include <Wire.h>
#include <Adafruit_GFX.h>
#include <Adafruit_SSD1306.h>
#include <Fonts/FreeSansBold24pt7b.h>
#define USESECUREMQTT
#define ESP8266BOARD

uint8_t INPUT_PIN = D5;
uint8_t LED_PIN = D4;

// const char* THINGSPEAK_URL = "https://api.thingspeak.com/update";
// -- Wifi stuff
char wifiSSID[] = SECRET_WIFI_SSID;
char wifiPassword[] = SECRET_WIFI_PASSWORD;

char thinspeakChannelId[] = SECRET_THINGSPEAK_CHANNEL_ID;

#ifdef ESP8266BOARD
  #include <ESP8266WiFi.h>
  const char* PROGMEM thingspeak_cert_thumbprint = "9780c25078532fc0fd03dae01bfd8c923fff9878";
#else
  #include <WiFi.h>
  const char * PROGMEM thingspeak_ca_cert = \
  "-----BEGIN CERTIFICATE-----\n" \
  "MIIDxTCCAq2gAwIBAgIQAqxcJmoLQJuPC3nyrkYldzANBgkqhkiG9w0BAQUFADBs\n" \
  "MQswCQYDVQQGEwJVUzEVMBMGA1UEChMMRGlnaUNlcnQgSW5jMRkwFwYDVQQLExB3\n" \
  "d3cuZGlnaWNlcnQuY29tMSswKQYDVQQDEyJEaWdpQ2VydCBIaWdoIEFzc3VyYW5j\n" \
  "ZSBFViBSb290IENBMB4XDTA2MTExMDAwMDAwMFoXDTMxMTExMDAwMDAwMFowbDEL\n" \
  "MAkGA1UEBhMCVVMxFTATBgNVBAoTDERpZ2lDZXJ0IEluYzEZMBcGA1UECxMQd3d3\n" \
  "LmRpZ2ljZXJ0LmNvbTErMCkGA1UEAxMiRGlnaUNlcnQgSGlnaCBBc3N1cmFuY2Ug\n" \
  "RVYgUm9vdCBDQTCCASIwDQYJKoZIhvcNAQEBBQADggEPADCCAQoCggEBAMbM5XPm\n" \
  "+9S75S0tMqbf5YE/yc0lSbZxKsPVlDRnogocsF9ppkCxxLeyj9CYpKlBWTrT3JTW\n" \
  "PNt0OKRKzE0lgvdKpVMSOO7zSW1xkX5jtqumX8OkhPhPYlG++MXs2ziS4wblCJEM\n" \
  "xChBVfvLWokVfnHoNb9Ncgk9vjo4UFt3MRuNs8ckRZqnrG0AFFoEt7oT61EKmEFB\n" \
  "Ik5lYYeBQVCmeVyJ3hlKV9Uu5l0cUyx+mM0aBhakaHPQNAQTXKFx01p8VdteZOE3\n" \
  "hzBWBOURtCmAEvF5OYiiAhF8J2a3iLd48soKqDirCmTCv2ZdlYTBoSUeh10aUAsg\n" \
  "EsxBu24LUTi4S8sCAwEAAaNjMGEwDgYDVR0PAQH/BAQDAgGGMA8GA1UdEwEB/wQF\n" \
  "MAMBAf8wHQYDVR0OBBYEFLE+w2kD+L9HAdSYJhoIAu9jZCvDMB8GA1UdIwQYMBaA\n" \
  "FLE+w2kD+L9HAdSYJhoIAu9jZCvDMA0GCSqGSIb3DQEBBQUAA4IBAQAcGgaX3Nec\n" \
  "nzyIZgYIVyHbIUf4KmeqvxgydkAQV8GK83rZEWWONfqe/EW1ntlMMUu4kehDLI6z\n" \
  "eM7b41N5cdblIZQB2lWHmiRk9opmzN6cN82oNLFpmyPInngiK3BD41VHMWEZ71jF\n" \
  "hS9OMPagMRYjyOfiZRYzy78aG6A9+MpeizGLYAiJLQwGXFK3xPkKmNEVX58Svnw2\n" \
  "Yzi9RKR/5CYrCsSXaQ3pjOLAEFe4yHYSkVXySGnYvCoCWw9E1CAx2/S6cCZdkGCe\n" \
  "vEsXCS+0yx5DaMkHJ8HSXPfqIbloEpw8nL+e/IBcm2PN7EeqJSdnoDfzAIJ9VNep\n" \
  "+OkuE6N36B9K\n" \
  "-----END CERTIFICATE-----\n";
#endif

#ifdef USESECUREMQTT
  #include <WiFiClientSecure.h>
  #define mqttPort 8883
  WiFiClientSecure client; 
#else
  #define mqttPort 1883
  WiFiClient client;
#endif

// MQTT related settings
char mqttUsername[] = SECRET_MQTT_USER_NAME;
char mqttClientId[] = SECRET_MQTT_CLIENT_ID;
char mqttPassword[] = SECRET_MQTT_PASSWORD;
const char* mqttServer = "mqtt3.thingspeak.com";
int mqttStatus = WL_IDLE_STATUS; 
long mqttLastPublishMillis = 0;
int mqttConnectionDelay = 1;
int mqttUpdateInterval = 15;
PubSubClient mqttClient(client);

// 'radiation', 128x64px
const unsigned char radiationLogo [] PROGMEM = {
	0xff, 0xff, 0xff, 0xff, 0xff, 0xff, 0xff, 0xff, 0xff, 0xff, 0xff, 0xff, 0xff, 0xff, 0xff, 0xff, 
	0xff, 0xff, 0xff, 0xff, 0xff, 0xff, 0xff, 0xff, 0xff, 0xff, 0xff, 0xff, 0xff, 0xff, 0xff, 0xff, 
	0xff, 0xff, 0xff, 0xff, 0xff, 0xff, 0xff, 0xff, 0xff, 0xff, 0xff, 0xff, 0xff, 0xff, 0xff, 0xff, 
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	0xff, 0xff, 0xff, 0xff, 0xff, 0xff, 0xff, 0xff, 0xff, 0xff, 0xff, 0xff, 0xff, 0xff, 0xff, 0xff
};

// OLED display
#define SCREEN_WIDTH 128
#define SCREEN_HEIGHT 64
#define OLED_RESET -1 // arduino reset pin
#define SCREEN_ADDRESS 0x3C // I2C address, see datasheet: https://cdn-shop.adafruit.com/datasheets/SSD1306.pdf
Adafruit_SSD1306 oledDisplay(SCREEN_WIDTH, SCREEN_HEIGHT, &Wire, OLED_RESET);

// ring buffer
#define RING_BUFFER_SIZE 2048

unsigned long ringBuffer [RING_BUFFER_SIZE] = {};
unsigned long rbPtr = 0;

#define SAMPLING_INTERVAL 250
unsigned long lastSamplingTS = 0;

void mprint(String str) {
  Serial.print(str);
  oledDisplay.print(str);
  oledDisplay.display();
}

void mprintln(String str) {
  Serial.println(str);
  oledDisplay.println(str);
  oledDisplay.display();
}

void connectWifi() {
  // mprintln(String("SSID: ") + wifiSSID);
  WiFi.begin(wifiSSID, wifiPassword);
  #ifdef ESP8266BOARD
    while (WiFi.waitForConnectResult() != WL_CONNECTED) {
  #else
    while (WiFi.status() != WL_CONNECTED) {
  #endif
    delay(500);
  }
  // mprintln(String("IP: ") + WiFi.localIP().toString());
}

void connectMQTT() {
  // mprintln("MQTT:");
  // mprintln(mqttServer);
  while (!mqttClient.connected()) {
    if (mqttClient.connect(mqttClientId, mqttUsername, mqttPassword)) {
      // mprintln("MQTT connected");
    } else {
      mprint("[mqtt] could not connect, state: ");
      mprintln(String(mqttClient.state()));
      mprintln("[mqtt] retrying...");
      delay(500);
    }
  }
}

void setupMQTT() {
  mqttClient.setServer(mqttServer, mqttPort); 
  #ifdef USESECUREMQTT
    #ifdef ESP8266BOARD
      client.setFingerprint(thingspeak_cert_thumbprint);
    #else
      client.setCACert(thingspeak_ca_cert);
    #endif
  #endif
}

void setupGPIO() {
  pinMode(INPUT_PIN, INPUT);
  pinMode(LED_PIN, OUTPUT);
  digitalWrite(LED_PIN, HIGH);
}

void setupOLED() {
  Serial.println("Setting up OLED...");
  if(!oledDisplay.begin(SSD1306_SWITCHCAPVCC, SCREEN_ADDRESS)) { // internal 3.3V display voltage
    mprintln(F("SSD1306 allocation failed"));
    for(;;);
  }

  delay(2000);
  oledDisplay.setTextSize(1);
  oledDisplay.setTextColor(SSD1306_WHITE);
  oledDisplay.cp437(true);
  oledDisplay.setFont(&FreeSansBold24pt7b);
  oledDisplay.clearDisplay();
  oledDisplay.drawBitmap(0, 0, radiationLogo, 128, 64, WHITE);
  oledDisplay.display();
}

void rbAdd(unsigned long value) {
  ringBuffer[++rbPtr % RING_BUFFER_SIZE] = value;
}

unsigned long rbGet(long offset = 0) {
  return ringBuffer[(rbPtr + offset) % RING_BUFFER_SIZE]; 
}

unsigned long getLastMinuteCount() {
  unsigned long counter = 0;
  unsigned long ts = millis();
  while (rbGet(-1 * counter) != 0 && ts - rbGet(-1 * counter) < 60000) {
    counter++;
  }

  return counter;
}

void ICACHE_RAM_ATTR isr() {
  unsigned long timestamp = millis();

  digitalWrite(LED_PIN, LOW);

  rbAdd(timestamp);

  if (WiFi.status() != WL_CONNECTED) {
    connectWifi();
  }

  if (!mqttClient.connected()) {
    connectMQTT();
  }

  String topicString = "channels/" + String(thinspeakChannelId) + "/publish";
  mqttClient.publish(topicString.c_str(), String(timestamp).c_str());
  digitalWrite(LED_PIN, HIGH);
}

void setup() {
  Serial.begin(115200);
  delay(300);

  setupOLED();

  // mprintln("");
  // mprintln("Starting up");

  setupGPIO();
  connectWifi();
  setupMQTT();
  connectMQTT();

  oledDisplay.clearDisplay();

  attachInterrupt(digitalPinToInterrupt(INPUT_PIN), isr, FALLING);

  lastSamplingTS = millis();
}

void loop() {
  mqttClient.loop();
  if (millis() - lastSamplingTS >= SAMPLING_INTERVAL) {
    lastSamplingTS = millis();
    oledDisplay.clearDisplay();
    oledDisplay.setCursor(32, 48);
    mprintln(String(getLastMinuteCount()));
  }
}
